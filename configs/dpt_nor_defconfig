## configs/dpt_nor_defconfig
```kconfig
BR2_mips=y
BR2_mips_32r2=y
BR2_KERNEL_HEADERS_4_1=y
BR2_GCC_VERSION_4_7_X=y
BR2_ENABLE_LOCALE_PURGE=y
BR2_ENABLE_LOCALE_WHITELIST="C"
# BR2_TARGET_ENABLE_ROOT_LOGIN is not set
BR2_LINUX_KERNEL=y
BR2_LINUX_KERNEL_USE_CUSTOM_CONFIG=y
BR2_LINUX_KERNEL_CUSTOM_CONFIG_FILE="$(BR2_EXTERNAL)/board/mips/dpt/linux-config"
BR2_LINUX_KERNEL_VMLINUZ_BIN=y
BR2_LINUX_KERNEL_INSTALL_TARGET=y
BR2_PACKAGE_MTD=y
BR2_TARGET_ROOTFS_SQUASHFS=y
BR2_TARGET_ROOTFS_SQUASHFS4_XZ=y
BR2_TARGET_BAREBOX=y
BR2_TARGET_BAREBOX_CUSTOM_GIT=y
BR2_TARGET_BAREBOX_CUSTOM_GIT_REPO_URL="https://github.com/frantony/barebox.git"
BR2_TARGET_BAREBOX_CUSTOM_GIT_VERSION="20160223.ar9331.wip"
BR2_TARGET_BAREBOX_USE_CUSTOM_CONFIG=y
BR2_TARGET_BAREBOX_CUSTOM_CONFIG_FILE="$(BR2_EXTERNAL)/board/mips/dpt/barebox_defconfig"
BR2_TARGET_BAREBOX_CUSTOM_EMBEDDED_ENV=y
BR2_TARGET_BAREBOX_CUSTOM_EMBEDDED_ENV_PATH="$(BR2_EXTERNAL)/board/mips/dpt/env"
```
